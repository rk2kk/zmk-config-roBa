## boards/shields/roBa/Kconfig.shield
```kconfig
config SHIELD_ROBA_DONGLE_DISPLAY
    def_bool $(shields_list_contains,roBa_dongle_display)

config SHIELD_ROBA_DONGLE_XIAO
    def_bool $(shields_list_contains,roBa_dongle_xiao)

config SHIELD_ROBA_DONGLE_RAYTAC
    def_bool $(shields_list_contains,roBa_dongle_raytac)

 config SHIELD_ROBA_L_CENTRAL
    def_bool $(shields_list_contains,roBa_L_central)   

config SHIELD_ROBA_L_PERIPHERAL
    def_bool $(shields_list_contains,roBa_L_peripheral)

config SHIELD_ROBA_R
    def_bool $(shields_list_contains,roBa_R)
```

## config/boards/shields/Test/Kconfig.shield
```kconfig
config SHIELD_ZMK_DONGLE
    def_bool $(shields_list_contains,zmk_dongle)

config SHIELD_ROBA_L
    def_bool $(shields_list_contains,roBa_L)

config SHIELD_ROBA_R
    def_bool $(shields_list_contains,roBa_R)
```
