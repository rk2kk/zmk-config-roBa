## config/west.yml
```yaml
manifest:
  remotes:
    - name: zmkfirmware
      url-base: https://github.com/zmkfirmware
    - name: badjeff
      url-base: https://github.com/badjeff
    - name: ssbb
      url-base: https://github.com/ssbb
    - name: caksoylar
      url-base: https://github.com/caksoylar
    - name: englmaxi
      url-base: https://github.com/englmaxi
    - name: minhe7735
      url-base: https://github.com/minhe7735
    - name: kot149
      url-base: https://github.com/kot149
      #dongle
    - name: rschenk
      url-base: https://github.com/rschenk
    - name: venator
      url-base: https://github.com/venator
    - name: rk2kk
      url-base: https://github.com/rk2kk
    - name: zettaface
      url-base: https://github.com/zettaface
    - name: te9no
      url-base: https://github.com/te9no
    - name: prospector
      url-base: https://github.com/t-ogura    
    - name: cormoran
      url-base: https://github.com/cormoran
      
  projects:
    # https://github.com/zmkfirmware/zmk
    #- name: zmk
    #  remote: zmkfirmware
    #  revision: main
    #  import: app/west.yml

    - name: zmk
      remote: cormoran
      revision: main+dya
      import:
      file: app/west.yml

    - name: zephyr
      remote: cormoran
      revision: v4.1.0+zmk-fixes+nrf-half-duplex-uart
      clone-depth: 1
      import:
      name-blocklist:
          - ci-tools
          - hal_altera
          - hal_cypress
          - hal_infineon
          - hal_microchip
          - hal_nxp
          - hal_openisa
          - hal_xtensa
          - hal_st
          - hal_ti
          - loramac-node
          - mcuboot
          - mcumgr
          - net-tools
          - openthread
          - edtt
          - trusted-firmware-m
      
     # https://github.com/badjeff/zmk-pmw3610-driver
    - name: zmk-pmw3610-driver
           remote: badjeff
           revision: main
      path: modules/zmk-pmw3610-driver-badjeff
    
    # https://github.com/kot149/zmk-pmw3610-driver-badjeff/tree/swap-invert-reg
    #- name: zmk-pmw3610-driver-badjeff
    #  remote: kot149
    #  revision: swap-invert-reg
    #  path: modules/zmk-pmw3610-driver-badjeff

    # https://github.com/ssbb/zmk-listeners
    - name: zmk-listeners
      remote: ssbb
      revision: v1

   # https://github.com/caksoylar/zmk-smart-toggle.git
    - name: zmk-smart-toggle
      remote: caksoylar
      revision: v0.3-branch
      path: modules/zmk-smart-toggle

    # https://github.com/caksoylar/zmk-rgbled-widget
    - name: zmk-rgbled-widget
      remote: caksoylar
      revision: main
      path: modules/zmk-rgbled-widget

    # https://github.com/kot149/zmk-mouse-gesture
    - name: zmk-mouse-gesture
      remote: kot149
      revision: v1
      path: modules/zmk-mouse-gesture

    # https://github.com/kot149/zmk-layout-shift
        # https://github.com/minhe7735/zmk-trackball-gestures-module
    - name: zmk-trackball-gestures-module
      remote: minhe7735
      revision: master

    - name: zmk-dongle-display
      remote: englmaxi
      revision: main

    - name: zmk-component-raytac-dongle
      remote: venator
      revision: main

    - name: zmk-input-processor-keybind
      remote: zettaface
      revision: main
      path: modules/zmk-input-processor-keybind-zettaface

    # https://github.com/badjeff/zmk-input-processor-report-rate-limit
    - name: zmk-input-processor-report-rate-limit
      remote: badjeff
      revision: main
      path: modules/zmk-input-processor-report-rate-limit
          # https://github.com/kot149/zmk-layout-shift

    - name: zmk-layout-shift
      remote: kot149
      revision: v1
      path: modules/zmk-layout-shift
    # https://github.com/kot149/zmk-scroll-snap

    - name: zmk-scroll-snap
      remote: kot149
      revision: v1
      path: modules/zmk-scroll-snap

    - name: prospector-zmk-module
      remote: prospector
      revision: v2.1.0  # Use v2.1.0 for ZMK 3.0+ (Zephyr 3.6.x+)
      path: modules/prospector-zmk-module

    - name: zmk-feature-custom-settings
      remote: cormoran
      revision: main
    - name: zmk-feature-fast-keymap
      remote: cormoran
      revision: main
        - name: zmk-module-ble-management
      remote: cormoran
      revision: main
    - name: zmk-module-battery-history
      remote: cormoran
      revision: main
    - name: zmk-module-settings-rpc
      remote: cormoran
      revision: main
    - name: zmk-module-runtime-input-processor
      remote: cormoran

  self:
    path: config
```
